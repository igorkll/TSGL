## espTSGL/examples/graphic_test/sdkconfig.defaults
```kconfig
CONFIG_PARTITION_TABLE_CUSTOM=y
CONFIG_PARTITION_TABLE_CUSTOM_FILENAME="partitions.csv"
CONFIG_PARTITION_TABLE_FILENAME="partitions.csv"

CONFIG_ESP_INT_WDT=y
CONFIG_ESP_TASK_WDT_EN=n
CONFIG_ESP_TASK_WDT_INIT=n
CONFIG_INT_WDT=y
CONFIG_TASK_WDT=n
CONFIG_ESP_TASK_WDT=n

CONFIG_ESP_MAIN_TASK_STACK_SIZE=8192
```
